## conf/bblayers.conf.sample
```bitbake
# POKY_BBLAYERS_CONF_VERSION is increased each time build/conf/bblayers.conf
# changes incompatibly
POKY_BBLAYERS_CONF_VERSION = "2"

BBPATH = "${TOPDIR}"
BBFILES ?= ""

BBLAYERS ?= " \
  ##OEROOT##/../poky/meta \
  ##OEROOT##/../poky/meta-poky \
  ##OEROOT##/../poky/meta-yocto-bsp \
  ##OEROOT##/../poky/meta-mangopi \
  ##OEROOT##/../poky/meta-arm/meta-arm-toolchain \
  ##OEROOT##/../poky/meta-openembedded/meta-oe \
  ##OEROOT##/../poky/meta-qt5 \
"
```

## conf/layer.conf
```bitbake
# We have a conf and classes directory, add to BBPATH
BBPATH .= ":${LAYERDIR}"

# We have recipes-* directories, add to BBFILES
BBFILES += "${LAYERDIR}/recipes-*/*/*.bb \
            ${LAYERDIR}/recipes-*/*/*.bbappend"

BBFILE_COLLECTIONS += "meta-mangopi"
BBFILE_PATTERN_meta-mangopi = "^${LAYERDIR}/"
BBFILE_PRIORITY_meta-mangopi = "5"

LAYERDEPENDS_meta-mangopi = "core"
LAYERSERIES_COMPAT_meta-mangopi = "dunfell"
```

## conf/machine/mangopi-mq.conf
```bitbake
#@TYPE: Machine
#@NAME: Mangopi-Mq (T113-S3)
#@DESCRIPTION: Reference machine configuration for https://mangopi.org/mangopi_mq boards

require conf/machine/include/tune-cortexa7.inc
SOC_FAMILY = "sun8i"
MACHINEOVERRIDES =. "sun8i"

PREFERRED_PROVIDER_virtual/kernel ?= "linux-mainline"
PREFERRED_PROVIDER_virtual/bootloader = "awboot"
EXTRA_IMAGEDEPENDS += "awboot"

KERNEL_IMAGETYPE = "zImage"
KERNEL_DEVICETREE_FILE = "sun8i-t113-mangopi-dual.dtb"
KERNEL_DEVICETREE = "allwinner/${KERNEL_DEVICETREE_FILE}"
IMAGE_BOOT_FILES ?= "\
    ${KERNEL_IMAGETYPE} \
    ${KERNEL_DEVICETREE_FILE} \
    "

MACHINE_ESSENTIAL_EXTRA_RRECOMMENDS = " kernel-modules"
MACHINE_ESSENTIAL_EXTRA_RDEPENDS = "kernel-image kernel-devicetree"

IMAGE_FSTYPES += "tar.bz2 ext4 wic wic.bmap"
IMAGE_INSTALL += "kernel-devicetree kernel-image-zimage"

WKS_FILE ?= "mangopi-mq-t113.wks"
WKS_FILE_DEPENDS ?= " \
    mtools-native \
    dosfstools-native \
    virtual/bootloader \
    virtual/kernel \
    "

SERIAL_CONSOLE ?= "115200 ttyS5"
MACHINE_FEATURES ?= "alsa apm keyboard rtc serial screen usbgadget usbhost vfat"
DISTRO_FEATURES_remove = "pci 3g nfc x11 opengl ptest multiarch wayland vulkan bluetooth"
```

## wic/mangopi-mq-t113.wks
```
# short-description: Create SD card image for MangoPi-MQ (T113) board
# long-description: Creates a partitioned SD card image for MangoPi-MQ (T113) board
# Boot files are located in the first vfat partition.
include t113-boot.wks

part / --source rootfs --ondisk mmcblk0 --fstype=ext4 --label root --align 4 --use-uuid
```

## wic/t113-boot.wks
```
# short-description: Create SD card image for T133-Sx SoC
# long-description: Creates a partitioned SD card image for T133-Sx SoC.
# Boot files are located in the first vfat partition.

part awboot     --align 8     --size 128K    --ondisk mmcblk0 --source rawcopy           --sourceparams="file=awboot-boot-sd.bin" --no-table
part /boot      --align 4096  --size 20480K  --ondisk mmcblk0 --source bootimg-partition --sourceparams="loader=u-boot" --fstype=vfat --label boot --active   --use-uuid
```
